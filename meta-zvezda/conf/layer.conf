## meta-zvezda/conf/layer.conf
```bitbake
# We have a conf and classes directory, add to BBPATH
BBPATH .= ":${LAYERDIR}"

# We have recipes-* directories, add to BBFILES
BBFILES += "${LAYERDIR}/recipes-*/*/*.bb \
            ${LAYERDIR}/recipes-*/*/*.bbappend"

BBFILE_COLLECTIONS += "zvezda-layer"
BBFILE_PATTERN_zvezda-layer := "^${LAYERDIR}/"
LAYERSERIES_COMPAT_zvezda-layer := "hardknott honister"
```

## meta-zvezda/conf/machine/include/zvezda.inc
```bitbake
OBMC_MACHINE_FEATURES += "\
        obmc-bmc-state-mgmt \
        obmc-chassis-state-mgmt \
        obmc-host-ipmi \
        obmc-host-state-mgmt \
        obmc-phosphor-chassis-mgmt \
        obmc-phosphor-fan-mgmt \
        obmc-phosphor-flash-mgmt \
        "

VIRTUAL-RUNTIME_skeleton_workbook = "${MACHINE}-config"
VIRTUAL-RUNTIME_obmc-host-state-manager ?= "pwr-ctrl"
VIRTUAL-RUNTIME_obmc-chassis-state-manager ?= "pwr-ctrl"


PREFERRED_PROVIDER:virtual/obmc-chassis-mgmt = "packagegroup-zvezda-apps"
PREFERRED_PROVIDER:virtual/obmc-fan-mgmt = "packagegroup-zvezda-apps"
PREFERRED_PROVIDER:virtual/obmc-flash-mgmt = "packagegroup-zvezda-apps"
PREFERRED_PROVIDER:virtual/obmc-inventory-data ?= "${VIRTUAL-RUNTIME_skeleton_workbook}"
PREFERRED_PROVIDER:virtual/obmc-system-mgmt = "packagegroup-zvezda-apps"

OVERRIDES .= ":zvezda"
```

## meta-zvezda/meta-iridium/conf/layer.conf
```bitbake
# We have a conf and classes directory, add to BBPATH
BBPATH .= ":${LAYERDIR}"

# We have recipes-* directories, add to BBFILES
BBFILES += "${LAYERDIR}/recipes-*/*/*.bb \
            ${LAYERDIR}/recipes-*/*/*.bbappend"

BBFILE_COLLECTIONS += "iridium-layer"
BBFILE_PATTERN_iridium-layer := "^${LAYERDIR}/"

LAYERSERIES_COMPAT_iridium-layer := "hardknott honister"
```

## meta-zvezda/meta-iridium/conf/machine/iridium.conf
```bitbake
KMACHINE = "aspeed"
KERNEL_DEVICETREE = "${KMACHINE}-bmc-zvezda-${MACHINE}.dtb"

UBOOT_MACHINE = "ast_g5_ncsi_config"

require conf/machine/include/zvezda.inc
require conf/machine/include/ast2500.inc
require conf/machine/include/obmc-bsp-common.inc

PREFERRED_PROVIDER_virtual/obmc-host-ctl ?= ""
FLASH_SIZE = "32768"
```

## meta-zvezda/meta-iridium32/conf/layer.conf
```bitbake
# We have a conf and classes directory, add to BBPATH
BBPATH .= ":${LAYERDIR}"

# We have recipes-* directories, add to BBFILES
BBFILES += "${LAYERDIR}/recipes-*/*/*.bb \
            ${LAYERDIR}/recipes-*/*/*.bbappend"

BBFILE_COLLECTIONS += "iridium32-layer"
BBFILE_PATTERN_iridium32-layer := "^${LAYERDIR}/"

LAYERSERIES_COMPAT_iridium32-layer := "hardknott honister"
```

## meta-zvezda/meta-iridium64/conf/machine/iridium64.conf
```bitbake
KMACHINE = "aspeed"
KERNEL_DEVICETREE = "${KMACHINE}-bmc-zvezda-${MACHINE}.dtb"

MACHINE_FEATURES += "\
        obmc-bmc-state-mgmt \
        obmc-host-state-mgmt \
        obmc-chassis-state-mgmt \
        obmc-phosphor-chassis-mgmt \
        obmc-phosphor-flash-mgmt \
        obmc-host-ipmi \
        obmc-phosphor-fan-mgmt \
        "

VIRTUAL-RUNTIME_obmc-host-state-manager ?= "x86-power-control"
VIRTUAL-RUNTIME_obmc-chassis-state-manager ?= "x86-power-control"
VIRTUAL-RUNTIME_obmc-discover-system-state ?= "x86-power-control"

PREFERRED_PROVIDER:virtual/obmc-chassis-mgmt = "packagegroup-zvezda-apps"
PREFERRED_PROVIDER:virtual/obmc-fan-mgmt = "packagegroup-zvezda-apps"
PREFERRED_PROVIDER:virtual/obmc-flash-mgmt = "packagegroup-zvezda-apps"
PREFERRED_PROVIDER:virtual/obmc-system-mgmt = "packagegroup-zvezda-apps"
PREFERRED_PROVIDER_virtual/obmc-host-ipmi-hw = "phosphor-ipmi-kcs"

OVERRIDES .= ":zvezda"

PREFERRED_PROVIDER_virtual/bootloader = "u-boot-aspeed"
PREFERRED_PROVIDER_u-boot = "u-boot-aspeed"
PREFERRED_PROVIDER_u-boot-fw-utils = "u-boot-fw-utils-aspeed"

UBOOT_MACHINE = "ast_g5_ncsi_config"

require conf/machine/include/ast2500.inc
require conf/machine/include/obmc-bsp-common.inc

PREFERRED_PROVIDER_virtual/obmc-host-ctl ?= ""
FLASH_SIZE = "65536"

DISTRO_VERSION = "1.1.1_rc1"
```
